## components/network/Kconfig
```kconfig
# WiFi Configuration

menu "WiFi Configuration"

    config WIFI_SSID
        string "WiFi SSID"
        default "MyWiFi"
        help
            SSID (network name) for the ESP32 to connect to.

    config WIFI_PASSWORD
        string "WiFi Password"
        default "password"
        help
            WiFi password (WPA or WPA2) for the ESP32 to use.

    config WIFI_CONNECT_TIMEOUT_MS
        int "WiFi connect timeout (ms)"
        default 30000
        range 5000 120000
        help
            Timeout in milliseconds for WiFi connection.
            If the ESP32 fails to connect within this time, it will retry.

    config WIFI_RECONNECT_INTERVAL_MS
        int "WiFi reconnect interval (ms)"
        default 5000
        range 1000 60000
        help
            Interval in milliseconds between WiFi reconnection attempts.

endmenu
```

## components/protocol/Kconfig
```kconfig
menu "Huawei Cloud IoT Configuration"

config HW_IOT_HOSTNAME
    string "MQTT Broker Hostname"
    default ""
    help
        MQTT broker address, e.g., xxx.iotda-device.cn-south-4.myhuaweicloud.com

config HW_IOT_PORT
    int "MQTT Broker Port"
    default 8883
    help
        MQTT broker TLS port

config HW_IOT_PRODUCTKEY
    string "Product Key"
    default ""
    help
        Product identifier from Huawei Cloud IoT

config HW_IOT_DEVICE_ID
    string "Device ID"
    default ""
    help
        Device identifier from Huawei Cloud IoT

config HW_IOT_CLIENT_ID
    string "MQTT Client ID"
    default ""
    help
        MQTT client identifier

config HW_IOT_USERNAME
    string "MQTT Username"
    default ""
    help
        MQTT username

config HW_IOT_PASSWORD
    string "MQTT Password / Device Secret"
    default ""
    help
        MQTT password or Device Secret

endmenu
```
